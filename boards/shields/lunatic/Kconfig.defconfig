## boards/shields/lunatic/Kconfig.defconfig
```kconfig
# Copyright (c) 2020 The ZMK Contributors
# SPDX-License-Identifier: MIT

if SHIELD_lunatic

config ZMK_KEYBOARD_NAME
    default "lunatic"

endif
```
