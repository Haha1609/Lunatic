#include "lunatic.dtsi"
#include "lunatic_3610.dtsi"



// 6rows here 
&kscan0 {
    col-gpios
            =<&gpio0 22 GPIO_ACTIVE_HIGH>, 
             <&gpio1 1 GPIO_ACTIVE_HIGH>, //0 24 
             <&gpio1 0 GPIO_ACTIVE_HIGH>,
             <&gpio0 11 GPIO_ACTIVE_HIGH>,  
             <&gpio1 4 GPIO_ACTIVE_HIGH>,
             <&gpio1 6 GPIO_ACTIVE_HIGH>
           ;  
};

&encoder_left {
    status = "okay";
};

&trackball_split {
    device = <&trackball>;
};