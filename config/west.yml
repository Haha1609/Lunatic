## config/west.yml
```yaml
manifest:
  remotes:
    - name: zmkfirmware
      url-base: https://github.com/zmkfirmware
    - name: inorichi
      url-base: https://github.com/inorichi
    - name: englmaxi
      url-base: https://github.com/englmaxi
    - name: badjeff
      url-base: https://github.com/badjeff
    - name: efogdev
      url-base: https://github.com/efogdev
  projects:
    - name: zmk
      remote: zmkfirmware
      revision: v0.3.0
      import: app/west.yml
    - name: zmk-pmw3610-driver
      remote: efogdev
      revision: zephyr-4.1
    - name: zmk-hid-trackball-interface
      remote: englmaxi
      revision: main
    - name: zmk-behavior-insomnia
      remote: badjeff
      revision: main
    - name: zmk-report-rate-limit
      remote: efogdev
      revision: main
    - name: zmk-input-processor-xyz
      remote: badjeff
      revision: main
  self:
    path: config
```
